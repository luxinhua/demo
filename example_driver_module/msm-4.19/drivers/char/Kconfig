## example_driver_module/msm-4.19/drivers/char/Kconfig
```kconfig
config START_LOAD_CORE
	bool "enable start load demo"
	default y
	help
	  Select this option if you want support for start load demo.
	  xhlu support it.
```

## example_driver_module/msm-4.19/drivers/char/star_load/Kconfig
```kconfig
config START_LOAD_CORE
  string "start load demo, just for show."
  default y
  help 
    this module enable support for start load demo 
	which is a virtual driver for debug. 
```
